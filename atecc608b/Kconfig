## statusLed/Kconfig
```kconfig
menu "MacDap Status Led"

	config STATUS_LED_GPIO_RANGE_MAX
		int
		default 33 if IDF_TARGET_ESP32
		default 46 if IDF_TARGET_ESP32S2
		default 48 if IDF_TARGET_ESP32S3
		default 18 if IDF_TARGET_ESP32C2
		default 19 if IDF_TARGET_ESP32C3
		default 30 if IDF_TARGET_ESP32C6

	choice STATUS_LED_COLOR_DRIVER
		prompt "Color Led Driver"
		default STATUS_LED_RMT_DRIVER
		help
			Select LED Driver.
		config STATUS_LED_RMT_DRIVER
			bool "RMT Led Driver"
			help
				RMT Led Driver.
		config STATUS_LED_SPI_DRIVER
			bool "SPI Led Driver"
			help
				SPI Led Driver.
	endchoice

	config STATUS_LED_GPIO
		int "Status Led GPIO number"
		default 4
		range 0 STATUS_LED_GPIO_RANGE_MAX
        help 
            GPIO pin number to be used as Status Led.

	config STATUS_LED_GPIO_COUNT
		int "Status Led GPIO Count"
		default 1
		range 1 1000
		help 
			Number of LEDs connected to the Status Led GPIO.
			
	config STATUS_LED_DEFAULT_BRIGHTNESS
		int "Status Led Default Brightness"
		default 10
		range 0 100
		help 
			Status Led Default Brightness.
		
endmenu
```
