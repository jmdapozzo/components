## atecc608b/Kconfig
```kconfig
menu "MacDap ATECC608B Configuration"

    config ATECC608B_I2C_PORT_NUM
        int "I2C Port Number"
        range 0 1
        default 0
        help
            I2C port number for ATECC608B communication. Must match the bus
            initialized by i2c_manager. Default is 0.

    config ATECC608B_I2C_ADDRESS
        hex "I2C Device Address (7-bit)"
        range 0x00 0x7F
        default 0x60
        help
            7-bit I2C address of the ATECC608B. The factory default for the
            ATECC608B is 0x60 (8-bit write address 0xC0). The address field
            is customer-configurable and can vary between 0x00 and 0x7F.
            Probe the I2C bus at boot if unsure.

    config ATECC608B_I2C_SPEED_HZ
        int "I2C Clock Speed (Hz)"
        range 100000 1000000
        default 400000
        help
            I2C clock speed for ATECC608B. Default is 400000 (400 kHz).

    config ATECC608B_OTP_MAGIC
        hex "OTP Zone Magic Number"
        default 0xACD42000
        help
            Magic number stored at offset 0 of the OTP zone to identify
            provisioned boards. Change this to a value unique to your product.

endmenu
```

## ble/Kconfig
```kconfig
menu "MacDap BLE Parameter Service Configuration"

    config BLE_PARAM_SERVICE_ENABLE
        bool "Enable BLE Parameter Service"
        default n
        help
            Enable Bluetooth LE parameter management service.
            Note: BLE requires significant memory (~60-80KB for Bluedroid, ~25-30KB for NimBLE).

    choice BLE_PARAM_SERVICE_STACK
        prompt "BLE Stack Selection"
        depends on BLE_PARAM_SERVICE_ENABLE
        default BLE_PARAM_SERVICE_USE_NIMBLE
        help
            Select which BLE stack to use. NimBLE uses much less memory than Bluedroid.

        config BLE_PARAM_SERVICE_USE_BLUEDROID
            bool "Use Bluedroid Stack (Higher Memory)"
            help
                Use ESP-IDF's Bluedroid BLE stack. More features but uses ~60-80KB RAM.

        config BLE_PARAM_SERVICE_USE_NIMBLE
            bool "Use NimBLE Stack (Lower Memory - Recommended)"
            help
                Use Apache NimBLE stack. Lighter weight, uses ~25-30KB RAM.
                This is recommended for memory-constrained applications.
    endchoice

    config BLE_PARAM_SERVICE_MTU_SIZE
        int "Preferred MTU size"
        depends on BLE_PARAM_SERVICE_ENABLE
        default 256
        range 23 512
        help
            Preferred MTU size for BLE communication.
            Lower values use less memory. 256 is a good balance.
            Use 512 for maximum throughput (default in design).

    config BLE_PARAM_SERVICE_MAX_PARAMS_IN_LIST
        int "Maximum parameters in single list response"
        depends on BLE_PARAM_SERVICE_ENABLE
        default 20
        range 5 100
        help
            Maximum number of parameters to include in a single list response.
            Lower values use less stack memory. Use chunking for larger lists.

    config BLE_PARAM_SERVICE_TASK_STACK_SIZE
        int "BLE service task stack size"
        depends on BLE_PARAM_SERVICE_ENABLE
        default 3072
        range 2048 8192
        help
            Stack size for BLE service tasks. Reduce if memory constrained.
            Minimum: 2048 bytes
            Default: 3072 bytes

    config BLE_PARAM_SERVICE_AUTO_START
        bool "Auto-start BLE service on boot"
        depends on BLE_PARAM_SERVICE_ENABLE
        default n
        help
            Automatically start BLE service during initialization.
            Disable to start BLE only when needed (on-demand).

    config BLE_PARAM_SERVICE_NOTIFICATIONS
        bool "Enable parameter change notifications"
        depends on BLE_PARAM_SERVICE_ENABLE
        default y
        help
            Enable real-time notifications for parameter changes.
            Disable to save memory if notifications are not needed.

endmenu

menu "BLE Memory Optimization (Bluedroid)"
    depends on BLE_PARAM_SERVICE_ENABLE && BLE_PARAM_SERVICE_USE_BLUEDROID

    config BTDM_CTRL_BLE_MAX_CONN
        int "Maximum number of BLE connections"
        default 1
        range 1 9
        help
            Reduce to 1 for single connection (saves memory).

    config BTDM_CTRL_BLE_MAX_CONN_EFF
        int
        default BTDM_CTRL_BLE_MAX_CONN

    # config BT_BLE_DYNAMIC_ENV_MEMORY
    #     bool "Use dynamic memory for BLE environment"
    #     default y
    #     help
    #         Enable to use heap instead of static memory for BLE.

endmenu
```

## digitalInput/Kconfig
```kconfig
menu "MacDap Digital Input Configuration"

    config DIGITAL_INPUT_EVENT_LOG
        bool "Log Digital Input events to console"
        default y
        help
            Enabling this option will log Digital Input events to console.
endmenu
```

## display/Kconfig
```kconfig
menu "MacDap Display Configuration"

    config LCD_CONTROLLER_GPIO_RANGE_MAX
		int
		default 33 if IDF_TARGET_ESP32
		default 46 if IDF_TARGET_ESP32S2
		default 48 if IDF_TARGET_ESP32S3
		default 18 if IDF_TARGET_ESP32C2
		default 19 if IDF_TARGET_ESP32C3
		default 30 if IDF_TARGET_ESP32C6
		default 27 if IDF_TARGET_ESP32H2

    choice DISPLAY_HEIGHT
        prompt "Height in pixels"
        default DISPLAY_HEIGHT_64
        help
            Height of the display in pixels. a.k.a vertical resolution

        config DISPLAY_HEIGHT_64
            bool "64"
        config DISPLAY_HEIGHT_32
            bool "32"
    endchoice

    config DISPLAY_HEIGHT
        int
        default 64 if DISPLAY_HEIGHT_64
        default 32 if DISPLAY_HEIGHT_32

    config I2C_LCD_CONTROLLER_ADDR
        hex "I2C LCD Controller Address"
        range 0 0x7f
        default 0x3C
        help
            I2C LCD Controller Address.

    config GPIO_RESET
        int "GPIO RESET pin number"
        range -1 LCD_CONTROLLER_GPIO_RANGE_MAX
        default -1
        help
            GPIO number (IOxx) to RESET.
            When it is -1, RESET isn't performed.

	choice DISPLAY_ROTATION_CHOICE
		prompt "Display Rotation"
		help
			Select Display Rotation
		config DISPLAY_ROTATION_0
            bool "0 degrees"
		config DISPLAY_ROTATION_90
			bool "90 degrees"
		config DISPLAY_ROTATION_180
			bool "180 degrees"
		config DISPLAY_ROTATION_270
			bool "270 degrees"
	endchoice

    config DISPLAY_ROTATION
        int
        default 0 if DISPLAY_ROTATION_0
        default 1 if DISPLAY_ROTATION_90
        default 2 if DISPLAY_ROTATION_180
        default 3 if DISPLAY_ROTATION_270

    config DISPLAY_WIDTH
        int "Display Width in pixels"
        default 128
        range 1 1024
        help
            Width of the display in pixels. a.k.a horizontal resolution

    config DISPLAY_HEIGHT
        int "Display Height in pixels"
        default 64 if SSD1306_HEIGHT_64
        default 32 if SSD1306_HEIGHT_32
        range 1 1024
        help
            Height of the display in pixels. a.k.a vertical resolution
        
endmenu
```

## eeprom/Kconfig
```kconfig
menu "MacDap EEPROM Configuration"

    choice EEPROM_MODEL
        prompt "EEPROM model"
        default EEPROM_24LC08B
        help
            Select EEPROM model

        config EEPROM_24LC08B
            bool "24LC08B (1KB / 8Kbit)"
    endchoice

    config I2C_EEPROM_BASE_ADDR
        hex "I2C EEPROM Base Address"
        range 0 0x7f
        default 0x50
        help
            I2C base address of the 24LC08B EEPROM.
            The 24LC08B uses 4 consecutive addresses (0x50-0x53) for its 4 blocks.
            Default is 0x50.

    config I2C_PORT_NUM
        int "I2C Port Number"
        range 0 1
        default 0
        help
            I2C port number to use for EEPROM communication. Default is 0.

endmenu
```

## eventLoop/Kconfig
```kconfig
menu "MacDap Event Loop Configuration"

    config EVENT_LOOP_LOG_ALL_EVENTS
        bool "Log Event Loop events to the console"
        default n
        help
            Enabling this option will log Event Loop events to console.

    config EVENT_LOOP_USE_DEDICATED_TASK
        bool "Use Dedicated Task for Event Loop"
        default n
        help
            Enabling this option will create a dedicated task for the event loop.

    config EVENT_LOOP_QUEUE_SIZE
        int "Queue Size"
        range 0 100
        default 10
            
        help
            Size of the event loop buffer.

    config EVENT_LOOP_TASK_STACK_SIZE
        int "Event Loop Task Stack Size"
        range 0 4096
        default 4096
        depends on EVENT_LOOP_USE_DEDICATED_TASK
        help
            Stack size for the event loop task.

    config EVENT_LOOP_LOCAL_TASK_PRIORITY
        int "Event Loop Task Priority"
        range 0 24
        default 2
        depends on EVENT_LOOP_USE_DEDICATED_TASK
        help
            Priority of local task.

endmenu
```

## gps/Kconfig
```kconfig
menu "MacDap GPS Configuration"

    # orsource "$PROJECT_DIR/env_caps/$IDF_TARGET/Kconfig.env_caps"
    orsource "$IDF_PATH/examples/common_components/env_caps/$IDF_TARGET/Kconfig.env_caps"

    config GPS_EVENT_LOG
        bool "Log GPS events to console"
        default n
        help
            Enabling this option will log GPS events to console.

	choice GPS_UART
		prompt "UART Number"
        default GPS_UART_NUMBER_0
		help
			Select GPS UART Number
		config GPS_UART_NUMBER_0
			bool "UART #0"
		config GPS_UART_NUMBER_1
			bool "UART #1"
		config GPS_UART_NUMBER_2
			bool "UART #2"
	endchoice
    
    config GPS_UART_NUMBER
        int
        default 0 if GPS_UART_NUMBER_0
        default 1 if GPS_UART_NUMBER_1
        default 2 if GPS_UART_NUMBER_2

    config GPS_UART_RXD
        int "UART RXD pin number"
        range ENV_GPIO_RANGE_MIN ENV_GPIO_IN_RANGE_MAX
        default 44 if GPS_UART_NUMBER_0
        default 18 if GPS_UART_NUMBER_1
        help
            GPIO number for UART RX pin. See UART documentation for more information
            about available pin numbers for UART.

    config GPS_UART_TXD
        int "UART TXD pin number"
        range ENV_GPIO_RANGE_MIN ENV_GPIO_IN_RANGE_MAX
        default 43 if GPS_UART_NUMBER_0
        default 17 if GPS_UART_NUMBER_1
        help
            GPIO number for UART TX pin. See UART documentation for more information
            about available pin numbers for UART.
    
    config GPS_PPS
        int "GPS PPS pin number"
        range -1 ENV_GPIO_IN_RANGE_MAX
        default -1
        help
            GPIO number for GPS PPS pin. See GPIO documentation for more information
            about available pin numbers for GPIO.

    config GPS_RING_BUFFER_SIZE
        int "GPS Ring Buffer Size"
        range 0 2048
        default 1024
        help
            Size of the ring buffer used for UART Rx channel.

    config GPS_LOCAL_TASK_STACK_SIZE
        int "GPS Local Task Stack Size"
        range 0 4096
        default 3072
        help
            Stack size of local task.

    config GPS_LOCAL_TASK_PRIORITY
        int "GPS Local Task Priority"
        range 0 24
        default 2
        help
            Priority of local task.

    menu "NMEA Statement Support"
        comment "At least one statement must be selected"
        config NMEA_STATEMENT_GGA
            bool "GGA Statement"
            default y
            help
                Enabling this option will parse the following parameter from GGA statement:

                - Latitude, Longitude, Altitude;
                - Number of satellites in use, fix status (no fix, GPS, DGPS), UTC time;

        config NMEA_STATEMENT_GSA
            bool "GSA Statement"
            default y
            help
                Enabling this option will parse the following parameter from GSA statement:

                - Position/Vertical/Horizontal dilution of precision;
                - Fix mode (no fix, 2D, 3D fix);
                - IDs of satellites in use;

        config NMEA_STATEMENT_GSV
            bool "GSV Statement"
            default y
            help
                Enabling this option will parse the following parameter from GSV statement:

                - Number of satellites in view;
                - Optional details of each satellite in view;

        config NMEA_STATEMENT_RMC
            bool "RMC Statement"
            default y
            help
                Enabling this option will parse the following parameter from RMC statement:

                - Validity of GPS signal;
                - Ground speed (knots) and course over ground (degrees);
                - Magnetic variation;
                - UTC date;

        config NMEA_STATEMENT_GLL
            bool "GLL Statement"
            default y
            help
                Enabling this option will parse the following parameter from GLL statement:

                - Latitude, Longitude;
                - UTC time;

        config NMEA_STATEMENT_VTG
            bool "VTG Statement"
            default y
            help
                Enabling this option will parse the following parameter from VTG statement:

                - Ground speed (knots, km/h) and course over ground (degrees);
                - Magnetic variation;

        config NMEA_STATEMENT_ZDA
            bool "ZDA Statement"
            default y
            help
                Enabling this option will parse the following parameter from ZDA statement:

                - UTC day, month, and year, and local time zone offset;

        config NMEA_STATEMENT_TXT
            bool "TXT Statement"
            default y
            help
                Enabling this option will parse the following parameter from TXT statement:

                - Text messages with different severity levels (Error, Warning, Notice, User);

    endmenu

endmenu
```

## ioExpander/Kconfig
```kconfig
menu "MacDap I/O Expander Configuration"

    choice IO_EXPANDER_MODEL
        prompt "I/O Expander model"
        default IO_EXPANDER_PCF8574
        help
            Select I/O Expander model

        config IO_EXPANDER_PCF8574
            bool "PCF8574/PCF8574A"
    endchoice

    config IO_EXPANDER_I2C_ADDR
        hex "I2C I/O Expander Address"
        range 0 0x7f
        default 0x20
        help
            I2C address of the PCF8574 I/O Expander.
            PCF8574: 0x20-0x27 (depending on A0-A2 pins)
            PCF8574A: 0x38-0x3F (depending on A0-A2 pins)
            Default is 0x20.

    config IO_EXPANDER_I2C_PORT_NUM
        int "I2C I/O Expander Port Number"
        range 0 1
        default 0
        help
            I2C port number to use for I/O Expander communication. Default is 0.

    config IO_EXPANDER_ENABLE_INTERRUPT
        bool "Enable interrupt support"
        default y
        help
            Enable interrupt support for pin change detection.
            The PCF8574 INT pin should be connected to the ESP32 GPIO
            specified below.

    config IO_EXPANDER_INTERRUPT_GPIO
        int "Interrupt GPIO pin"
        depends on IO_EXPANDER_ENABLE_INTERRUPT
        range -1 48
        default 5
        help
            GPIO pin connected to the PCF8574 INT pin.
            The INT pin goes low when any input pin changes state.
            Set to -1 to disable interrupt support.

    config IO_EXPANDER_DEBOUNCE_MS
        int "Debounce time in milliseconds"
        depends on IO_EXPANDER_ENABLE_INTERRUPT
        range 1 1000
        default 50
        help
            Debounce time in milliseconds for interrupt detection.
            This prevents multiple interrupts from mechanical switch bounce.
            Typical values: 10-100ms for buttons, 1-10ms for digital signals.

endmenu
```
