## ledMatrix/Kconfig
```kconfig
menu "MacDap Led Matrix"

	config LED_MATRIX_GPIO_RANGE_MAX
		int
		default 33 if IDF_TARGET_ESP32
		default 46 if IDF_TARGET_ESP32S2
		default 48 if IDF_TARGET_ESP32S3
		default 18 if IDF_TARGET_ESP32C2
		default 19 if IDF_TARGET_ESP32C3
		default 30 if IDF_TARGET_ESP32C6

	config LED_MATRIX_HUB75_R1
		int "R1 GPIO number"
		default 42
		range 0 LED_MATRIX_GPIO_RANGE_MAX

	config LED_MATRIX_HUB75_G1
		int "G1 GPIO number"
		default 41
		range 0 LED_MATRIX_GPIO_RANGE_MAX

	config LED_MATRIX_HUB75_B1
		int "B1 GPIO number"
		default 40
		range 0 LED_MATRIX_GPIO_RANGE_MAX

	config LED_MATRIX_HUB75_R2
		int "R2 GPIO number"
		default 38
		range 0 LED_MATRIX_GPIO_RANGE_MAX

	config LED_MATRIX_HUB75_G2
		int "G2 GPIO number"
		default 39
		range 0 LED_MATRIX_GPIO_RANGE_MAX

	config LED_MATRIX_HUB75_B2
		int "B2 GPIO number"
		default 37
		range 0 LED_MATRIX_GPIO_RANGE_MAX

	config LED_MATRIX_HUB75_ADDRA
		int "ADDRA GPIO number"
		default 45
		range 0 LED_MATRIX_GPIO_RANGE_MAX

	config LED_MATRIX_HUB75_ADDRB
		int "ADDRB GPIO number"
		default 36
		range 0 LED_MATRIX_GPIO_RANGE_MAX

	config LED_MATRIX_HUB75_ADDRC
		int "ADDRC GPIO number"
		default 48
		range 0 LED_MATRIX_GPIO_RANGE_MAX

	config LED_MATRIX_HUB75_ADDRD
		int "ADDRD GPIO number"
		default 35
		range 0 LED_MATRIX_GPIO_RANGE_MAX

	config LED_MATRIX_HUB75_ADDRE
		int "ADDRE GPIO number"
		default 21
		range -1 LED_MATRIX_GPIO_RANGE_MAX

	config LED_MATRIX_HUB75_CLK
		int "CLK GPIO number"
		default 2
		range 0 LED_MATRIX_GPIO_RANGE_MAX

	config LED_MATRIX_HUB75_LAT
		int "LAT GPIO number"
		default 47
		range 0 LED_MATRIX_GPIO_RANGE_MAX

	config LED_MATRIX_HUB75_OE
		int "OE GPIO number"
		default 14
		range 0 LED_MATRIX_GPIO_RANGE_MAX

	choice LED_MATRIX_MODULE_TYPE
		prompt "Module Format"
		help
			Select LED Panel Matrix Module Format
		config LED_MATRIX_TYPE_X64Y32
			bool "64 x 32"
		config LED_MATRIX_TYPE_X64Y64
			bool "64 x 64"
		config LED_MATRIX_TYPE_X128Y64
			bool "128 x 64"
	endchoice

	config LED_MATRIX_PIXEL_WIDTH
		int
		default 64 if LED_MATRIX_TYPE_X64Y32
		default 64 if LED_MATRIX_TYPE_X64Y64
		default 128 if LED_MATRIX_TYPE_X128Y64

	config LED_MATRIX_PIXEL_HEIGHT
		int
		default 32 if LED_MATRIX_TYPE_X64Y32
		default 64 if LED_MATRIX_TYPE_X64Y64
		default 64 if LED_MATRIX_TYPE_X128Y64

	config LED_MATRIX_MODULE_WIDTH
		int "Panel Module Width"
		default 1
		range 1 16

	config LED_MATRIX_MODULE_HEIGHT
		int "Panel Module Height"
		default 1
		range 1 16

endmenu
```

## ledMatrix/examples/x64y32/main/Kconfig.projbuild
```kconfig
menu "Test Application Configuration"

    config DISPLAY_LOGO
        bool "Display Logo on led matrix"
        default y
        help
            Enabling this option will display the logo on the led matrix.

    config DISPLAY_GREETING
        bool "Display Greeting on led matrix"
        default y
        help
            Enabling this option will display the greeting on the led matrix.

    config DISPLAY_MAIN_MESSAGE
        bool "Display Main Message on led matrix"
        default y
        help
            Enabling this option will display the main message on the led matrix.

    config DISPLAY_QR_CODE
        bool "Display QR Code on led matrix"
        default y
        help
            Enabling this option will display the QR code on the led matrix.

    config DISPLAY_DOT
        bool "Display Dot on led matrix"
        default y
        help
            Enabling this option will display the dot on the led matrix.
    
    config DISPLAY_HORIZONTAL_LINE
        bool "Display Horizontal Line on led matrix"
        default y
        help
            Enabling this option will display the horizontal line on the led matrix.
    
    config DISPLAY_VERTICAL_LINE
        bool "Display Vertical Line on led matrix"
        default y
        help
            Enabling this option will display the vertical line on the led matrix.

    config DISPLAY_X
        bool "Display X on led matrix"
        default y
        help
            Enabling this option will display the X on the led matrix.

    config DISPLAY_MESSAGE
        bool "Display Message on led matrix"
        default y
        help
            Enabling this option will display the message on the led matrix.

    config DISPLAY_SPINNER
        bool "Display Spinner on led matrix"
        default y
        help
            Enabling this option will display the spinner on the led matrix.

    config DISPLAY_LED
        bool "Display LED on led matrix"
        default y
        help
            Enabling this option will display the LED on the led matrix.

    config DISPLAY_TOP_BOTTOM_MESSAGE
        bool "Display Top and Bottom Message on led matrix"
        default y
        help
            Enabling this option will display the top and bottom message on the led matrix.

endmenu
```

## ledPanel/Kconfig
```kconfig
menu "MacDap Led Panel"

	config LED_PANEL_GPIO_RANGE_MAX
		int
		default 33 if IDF_TARGET_ESP32
		default 46 if IDF_TARGET_ESP32S2
		default 48 if IDF_TARGET_ESP32S3
		default 18 if IDF_TARGET_ESP32C2
		default 19 if IDF_TARGET_ESP32C3
		default 30 if IDF_TARGET_ESP32C6

	choice LED_PANEL_TYPE
		prompt "Type"
		default LED_PANEL_TYPE_MBI5026
		help
			Select LED Panel Type
		config LED_PANEL_TYPE_MBI5026
			bool "MBI5026 Led Panel Type"
			help
				MBI5026 Led Panel Type
		config LED_PANEL_TYPE_MAX7219
			bool "MAX7219 Led Panel Type"
			help
				MAX7219 Led Panel Type
	endchoice

	choice LED_PANEL_INTERFACE
		prompt "Interface"
		default LED_PANEL_INTERFACE_GPIO
		help
			Select LED Panel Interface
		config LED_PANEL_INTERFACE_GPIO
			bool "GPIO Interface"
			help
				GPIO Interface
		config LED_PANEL_INTERFACE_SPI
			bool "SPI Interface"
			help
				SPI Interface
	endchoice

	config LED_PANEL_EN
		int "ENABLE GPIO number"
		default 14
		range 0 LED_PANEL_GPIO_RANGE_MAX

	config LED_PANEL_DATA
		int "DATA GPIO number"
		default 11
		range 0 LED_PANEL_GPIO_RANGE_MAX

	config LED_PANEL_LATCH
		int "LATCH GPIO number"
		default 10
		range 0 LED_PANEL_GPIO_RANGE_MAX

	config LED_PANEL_CLOCK
		int "CLOCK GPIO number"
		default 12
		range 0 LED_PANEL_GPIO_RANGE_MAX

	choice LED_PANEL_DISPLAY_TYPE
		prompt "Display Type"
		default LED_PANEL_MATRIX_DISPLAY_TYPE
		help
			Select LED Panel Display Type
		config LED_PANEL_MATRIX_DISPLAY_TYPE
			bool "Dot Matrix display"
		config LED_PANEL_SEGMENT_DISPLAY_TYPE
			bool "NOT IMPLEMENTED 7-Segment display"
	endchoice

	if LED_PANEL_MATRIX_DISPLAY_TYPE
		choice LED_PANEL_MATRIX
			prompt "Matrix Module Format"
			help
				Select LED Panel Matrix
			config LED_PANEL_MATRIX_M12_6X8
				depends on LED_PANEL_TYPE_MBI5026
				bool "6w x 8h, 12 inch, 5 led/pixel or 9 led/pixel"
			config LED_PANEL_MATRIX_M6_12X8
				depends on LED_PANEL_TYPE_MBI5026
				bool "12h x 8h, 6 inch, 4 led/pixel"
			config LED_PANEL_MATRIX_M6_16X8
				depends on LED_PANEL_TYPE_MBI5026
				bool "16h x 8h, 6 inch, 3 led/pixel"
			config LED_PANEL_MATRIX_M4_24X8
				depends on LED_PANEL_TYPE_MBI5026
				bool "24w x 8h, 4 inch, 1 led/pixel"
			config LED_PANEL_MATRIX_MAX_8X8
				depends on LED_PANEL_TYPE_MAX7219
				bool "8w x 8h, 1 led/pixel"
			config LED_PANEL_MATRIX_MAX_32X8
				depends on LED_PANEL_TYPE_MAX7219
				bool "32w x 8, 1 led/pixel"
		endchoice

		config LED_PANEL_MATRIX_WIDTH
			int
			default 6  if LED_PANEL_MATRIX_M12_6X8
			default 12 if LED_PANEL_MATRIX_M6_12X8
			default 16 if LED_PANEL_MATRIX_M6_16X8
			default 24 if LED_PANEL_MATRIX_M4_24X8
			default 8  if LED_PANEL_MATRIX_MAX_8X8
			default 32 if LED_PANEL_MATRIX_MAX_32X8

		config LED_PANEL_MATRIX_HEIGHT
			int
			default 8  if LED_PANEL_MATRIX_M12_6X8
			default 8  if LED_PANEL_MATRIX_M6_12X8
			default 8  if LED_PANEL_MATRIX_M6_16X8
			default 8  if LED_PANEL_MATRIX_M4_24X8
			default 8  if LED_PANEL_MATRIX_MAX_8X8
			default 8  if LED_PANEL_MATRIX_MAX_32X8
	endif

	if LED_PANEL_SEGMENT_DISPLAY_TYPE
		choice LED_PANEL_SEGMENT
			prompt "Segment Module Format"
			help
				Select LED Panel Segment
			config S4_LED_PANEL_SEGMENT
				bool "4, 7-segment display"
			config S6_LED_PANEL_SEGMENT
				bool "6, 7-segment display"
			config S8_LED_PANEL_SEGMENT
				bool "8, 7-segment display"
		endchoice

		config LED_PANEL_SEGMENT_WIDTH
			int
			default 4 if S4_LED_PANEL_SEGMENT
			default 6 if S6_LED_PANEL_SEGMENT
			default 8 if S8_LED_PANEL_SEGMENT
	endif

	config LED_PANEL_MODULE_WIDTH
		int "Panel Module Width"
		default 1
		range 0 10

	config LED_PANEL_MODULE_HEIGHT
		int "Panel Module Width"
		default 1
		range 0 10

	config LED_PANEL_MAX7219_MODULE_CHIP_NB
		depends on LED_PANEL_TYPE_MAX7219
		int
		default 1  if LED_PANEL_MATRIX_MAX_8X8
		default 4 if LED_PANEL_MATRIX_MAX_32X8

	if LED_PANEL_TYPE_MBI5026

		config LED_PANEL_LEDC_TIMER
			int "LEDC timer_num"
			default 0
			range 0 3
		
		config LED_PANEL_LEDC_CHANNEL
			int "LEDC channel"
			default 5
			range 0 7

		config LED_PANEL_LEDC_MODE
			int "LEDC speed_mode"
			default 0
			range 0 1

		config LED_PANEL_LEDC_DUTY_RES
			int "LEDC duty_resolution"
			default 13
			range 1 13

		config LED_PANEL_LEDC_FREQUENCY
			int "LEDC freq_hz"
			default 1000

		config LED_PANEL_INITIAL_DUTY_CYCLE
			int "LEDC Initial Duty Cycle"
			default 0
			range 0 100
	endif

endmenu
```

## lightSensor/Kconfig
```kconfig
menu "MacDap Light Sensor Configuration"

    choice LIGHT_SENSOR
        prompt "Light Sensor model"
        default LIGHT_SENSOR_BH1750
        help
            Select Light Sensor model

        config LIGHT_SENSOR_BH1750
            bool "BH1750"
    endchoice

    config I2C_LIGHT_SENSOR_ADDR
        hex "I2C Light Sensor Address"
        range 0 0x7f
        default 0x23
        help
            I2C Light Sensor Address.

    config LIGHT_SENSOR_POLLING_INTERVAL_SEC
        int "Light Sensor Polling Interval (Seconds)"
        range 0 3600
        default 5
        help
            Interval in seconds between light sensor readings. Set to 0 to disable polling.

endmenu
```

## macdap_management/Kconfig
```kconfig
menu "MacDap Management"

    config REST_SERVICE_ENDPOINT
        string "Connection"
        default "https://my-domain.com"
        help
            Service point connection url.

endmenu
```

## oledDisplay/Kconfig
```kconfig
menu "MacDap Display Configuration"

    choice OLED_DISPLAY_WIDTH_CHOICE
        prompt "Width in pixels"
        default OLED_DISPLAY_WIDTH_CHOICE_128
        help
            Width of the display in pixels. a.k.a horizontal resolution
        config OLED_DISPLAY_WIDTH_CHOICE_128
            bool "128"
    endchoice

    config OLED_DISPLAY_WIDTH
        int
        default 128 if OLED_DISPLAY_WIDTH_CHOICE_128

        choice OLED_DISPLAY_HEIGHT_CHOICE
        prompt "Height in pixels"
        default OLED_DISPLAY_HEIGHT_CHOICE_64
        help
            Height of the display in pixels. a.k.a vertical resolution

        config OLED_DISPLAY_HEIGHT_CHOICE_64
            bool "64"
        config OLED_DISPLAY_HEIGHT_CHOICE_32
            bool "32"
    endchoice

    config OLED_DISPLAY_HEIGHT
        int
        default 64 if OLED_DISPLAY_HEIGHT_CHOICE_64
        default 32 if OLED_DISPLAY_HEIGHT_CHOICE_32

    config OLED_DISPLAY_I2C_ADDR
        hex "I2C LCD Controller Address"
        range 0 0x7f
        default 0x3C
        help
            I2C LCD Controller Address.

    config OLED_DISPLAY_GPIO_RESET
        int "GPIO RESET pin number"
        range -1 SOC_GPIO_OUT_RANGE_MAX
        default -1
        help
            GPIO number (IOxx) to RESET.
            When -1, RESET isn't performed.

	choice OLED_DISPLAY_ROTATION_CHOICE
		prompt "Display Rotation"
		help
			Select Display Rotation
		config OLED_DISPLAY_ROTATION_0
            bool "0 degrees"
		config OLED_DISPLAY_ROTATION_90
			bool "90 degrees"
		config OLED_DISPLAY_ROTATION_180
			bool "180 degrees"
		config OLED_DISPLAY_ROTATION_270
			bool "270 degrees"
	endchoice

    config OLED_DISPLAY_ROTATION
        int
        default 0 if OLED_DISPLAY_ROTATION_0
        default 1 if OLED_DISPLAY_ROTATION_90
        default 2 if OLED_DISPLAY_ROTATION_180
        default 3 if OLED_DISPLAY_ROTATION_270
endmenu
```

## oledDisplay/examples/oledDisplayTest/main/Kconfig.projbuild
```kconfig
menu "Display Test Configuration"

    config GPIO_I2C_SCL
        int "GPIO I2C SCL pin"
        default 9
        help
            GPIO pin number to be used as option switch.
        
    config GPIO_I2C_SDA
        int "GPIO I2C SDA pin"
        default 8
        help
            GPIO pin number to be used as option switch.
        
endmenu
```

## parameterManager/Kconfig
```kconfig
menu "Parameter Manager"

    config PARAMETER_MANAGER_MAX_PARAMS
        int "Maximum number of parameters"
        default 50
        range 1 200
        help
            Maximum number of parameters that can be registered.
            Each parameter consumes memory for metadata storage.

    config PARAMETER_MANAGER_NVS_NAMESPACE
        string "NVS namespace for parameters"
        default "app_params"
        help
            NVS namespace used for storing parameters.
            Must be unique and max 15 characters.

    config PARAMETER_MANAGER_ENABLE_LOGGING
        bool "Enable detailed parameter logging"
        default y
        help
            Enable detailed logging for parameter operations (create, set, get, delete).
            Useful for debugging but adds code size.

endmenu
```

## rtc/Kconfig
```kconfig
menu "MacDap RTC Configuration"

    choice RTC_MODEL
        prompt "RTC model"
        default RTC_MCP7940
        help
            Select RTC model

        config RTC_MCP7940
            bool "MCP7940"
    endchoice

    config I2C_RTC_ADDR
        hex "I2C RTC Address"
        range 0 0x7f
        default 0x6F
        help
            I2C address of the MCP7940 RTC. Default is 0x6F.

    config I2C_PORT_NUM
        int "I2C Port Number"
        range 0 1
        default 0
        help
            I2C port number to use for RTC communication. Default is 0.

    config RTC_AUTO_SYNC_TO_SYSTEM
        bool "Automatically sync system time from RTC on boot"
        default y
        help
            If enabled, the system time will be synchronized from the RTC
            during initialization. This is useful to maintain time across
            reboots when network is not available.

    config RTC_AUTO_SYNC_FROM_NTP
        bool "Automatically sync RTC from system time after NTP sync"
        default y
        help
            If enabled, the RTC will be synchronized from the system time
            whenever NTP synchronization completes successfully. This keeps
            the RTC accurate when network is available.

    config RTC_ENABLE_BATTERY_BACKUP
        bool "Enable battery backup by default"
        default y
        help
            If enabled, battery backup will be enabled during initialization.
            This allows the RTC to maintain time when main power is lost.

endmenu
```

## statusBuzzer/Kconfig
```kconfig
menu "MacDap Status Buzzer"

	config STATUS_BUZZER_GPIO_RANGE_MAX
		int
		default 33 if IDF_TARGET_ESP32
		default 46 if IDF_TARGET_ESP32S2
		default 48 if IDF_TARGET_ESP32S3
		default 18 if IDF_TARGET_ESP32C2
		default 19 if IDF_TARGET_ESP32C3
		default 30 if IDF_TARGET_ESP32C6

	config STATUS_BUZZER_GPIO
		int "Status Buzzer GPIO number"
		default 3
		range 0 STATUS_BUZZER_GPIO_RANGE_MAX
        help
            GPIO pin number to be used for Status Buzzer (SMT-0540).

	config STATUS_BUZZER_FREQUENCY
		int "Status Buzzer Frequency (Hz)"
		default 4000
		range 1000 10000
		help
			Status Buzzer operating frequency in Hz. SMT-0540 optimal frequency is 4000Hz.

endmenu
```
